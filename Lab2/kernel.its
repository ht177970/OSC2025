## Lab2/kernel.its
```
/dts-v1/;

/ {
    description = "U-boot FIT Image for RV2";
    images {
        kernel {
            description = "Kernel Image";
            data = /incbin/("build/kernel.bin");
            type = "kernel";
            arch = "riscv";
            os = "linux";
            compression = "none";
            load = <0x0 0x00200000>;
            entry = <0x0 0x00200000>;
        };
        fdt {
            description = "Flat Device Tree";
            data = /incbin/("../../x1_orangepi-rv2.dtb");
			type = "flat_dt";
			arch = "riscv";
			compression = "none";
			load = <0x0 0x31000000>;
        };
    };

	configurations {
		default = "conf";

		conf {
			description = "NYCU RV2 KERNEL";
			kernel = "kernel";
			fdt = "fdt";
		};
	};
};
```
